#include <U8glib.h>
#include <string.h>
#include <RTClib.h>
#include <Wire.h>

U8GLIB_ST7920_128X64_1X lcd(13, 11, 10);

RTC_DS1307 rtc;

String query = "GET /wid/queryDFSRSS.jsp?zone=1132068100 HTTP/1.1\r\nHost: www.kma.go.kr\r\nConnection: close\r\n\r\n";

const char* sky[4] = { "\x20", "\x20\x21", "\x21", "\x21\x21" };

const char* rainstatus[3] = { "\x22", "\x22\23", "\x23" };

const char* todayStr[4] = { "Sunny", "Partly Cloudy", "Partly Sunny", "Cloudy" };

const uint8_t rook_bitmap[] U8G_PROGMEM = {
  0x00, 0x00, 0x00, 0x00, 0x00, 0x20, 0x00, 0x00, 0x00, 0x00, 0x08, 0x00, 0x00, 0x00, 0x00, 0x00,
  0x00, 0x00, 0x00, 0x00, 0x00, 0x20, 0x00, 0x00, 0x00, 0x00, 0x08, 0x00, 0x00, 0x00, 0x00, 0x00,
  0x00, 0x00, 0x00, 0x00, 0x00, 0x20, 0x00, 0x00, 0x00, 0x00, 0x08, 0x00, 0x00, 0x00, 0x00, 0x00,
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  0x00, 0x00, 0x00, 0x00, 0x00, 0x20, 0x00, 0x00, 0x00, 0x00, 0x08, 0x00, 0x00, 0x00, 0x00, 0x00
};

int temperature[5];
int skycode[5];
int pop[5];
int pty[5];
int flag = 0;
int HOUR;
int ptyMax = 0;
int TODAY = 0;

void draw() {
  lcd.setFont(u8g_font_8x13);
  lcd.drawStr(1, 10, "06");
  lcd.drawStr(26, 10, "09");
  lcd.drawStr(51, 10, "12");
  lcd.drawStr(76, 10, "15");
  lcd.drawStr(101, 10, "18");
}

void writing(int i) {
  if (Serial1.find("<temp>")) {
    temperature[i] = Serial1.parseInt();
    Serial.print("temp:");
    Serial.println(temperature[i]);
  }
  if (Serial1.find("<sky>")) {
    skycode[i] = Serial1.parseInt();
    Serial.print("sky:");
    Serial.println(skycode[i]);
  }
  if (Serial1.find("<pty>")) {
    pty[i] = Serial1.parseInt();
    Serial.print("pty:");
    Serial.println(pty[i]);
  }
  if (Serial1.find("<pop>")) {
    pop[i] = Serial1.parseInt();
    Serial.print("pop:");
    Serial.println(pop[i]);
  }
}

void setup() {
  Serial.begin(9600);
  Serial1.begin(9600);
  pinMode(2, INPUT_PULLUP);
  pinMode(22, OUTPUT);
  Wire.begin();
  rtc.begin();
  rtc.adjust(DateTime(__DATE__, __TIME__));
  Serial.println("hiHello");
}

void error() {
  lcd.setColorIndex(0);
  lcd.drawBox(1, 1, 64, 128);
  lcd.setFont(u8g_font_8x13);
  lcd.println("Error");
  lcd.println("Wifi");
  lcd.println("disconnected");
  lcd.clearWriteError();
}

void loop() {
  if (digitalRead(2) == LOW) {
    delay(1000);
    Serial1.println("AT+CWJAP=\"SK_WiFiGIGAE3E8_2.4G\",\"CCY3B@7401\"");
    Serial.println("SW = LOW");
    digitalWrite(22, HIGH);
    delay(1000);
    digitalWrite(22, LOW);
    delay(1000);
    digitalWrite(22, HIGH);
    delay(1000);
    digitalWrite(22, LOW);
  }
  DateTime now = rtc.now();
  if (now.hour() % 3 == 2 && now.minute() == 0 && now.second() == 0) {
    Serial1.println("AT+CIPSTART=\"TCP\",\"www.kma.go.kr\",80");
    delay(200);
    Serial1.println("AT+CIPSEND=" + String(query.length()));
    delay(200);
    Serial1.println(query);
    for (int i = 0; i < 5; i++) {
      if (Serial1.find("<data seq=")) {
        writing(i);
      }
    }
    HOUR = now.hour() + 1;
  }
  lcd.firstPage();
  do {
    float skyCodeTotal = 0;
    for (int i = 0; i < 5; i++) {
      lcd.setFont(u8g_font_8x13);
      lcd.setPrintPos(1 + i * 26, 10);
      if (HOUR + i * 3 >= 24)
        lcd.print(HOUR + i * 3 - 24);
      else
        lcd.print(HOUR + i * 3);
      lcd.setFont(u8g_font_6x10);
      lcd.setPrintPos(1 + i * 26, 22);
      lcd.print(temperature[i]);
      lcd.print("\xb0\C");
      if (pty[i] > 0) {
        lcd.setFont(u8g_font_unifont_76);
        lcd.setPrintPos(1 + i * 26, 35);
        lcd.print(rainstatus[pty[i] - 1]);
        lcd.setFont(u8g_font_6x10);
      } else {
        lcd.setFont(u8g_font_unifont_76);
        lcd.setPrintPos(1 + i * 26, 35);
        lcd.print(sky[skycode[i] - 1]);
        lcd.setFont(u8g_font_6x10);
      }
      lcd.setPrintPos(1 + i * 26, 43);
      lcd.print(pop[i]);
      lcd.write('%');
      if (pty[i] > ptyMax)
        ptyMax = pty[i];
      skyCodeTotal += skycode[i];
    }
    float skyCodeAVG = skyCodeTotal / 5;
    if (skyCodeAVG < 1.5)
      TODAY = 0;
    else if (skyCodeAVG > 1.5 && skyCodeAVG < 2.5)
      TODAY = 1;
    else if (skyCodeAVG > 2.5 && skyCodeAVG < 3.5)
      TODAY = 2;
    else if(skyCodeAVG > 3.5)
      TODAY = 3;
    if (ptyMax > 0) {
      lcd.setPrintPos(1, 62);
      lcd.print("Take Umbrella");
    } else {
      lcd.setPrintPos(1, 62);
      lcd.print(todayStr[TODAY]);
    }
  } while (lcd.nextPage());
}
